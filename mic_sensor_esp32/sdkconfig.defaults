## mic_sensor_esp32/sdkconfig.defaults
```kconfig
# Bluetooth with the NimBLE
CONFIG_BT_ENABLED=y
CONFIG_BT_NIMBLE_ENABLED=y
CONFIG_BT_CONTROLLER_ENABLED=y
CONFIG_BT_NIMBLE_MAX_CONNECTIONS=1

# Classic ESP32: BLE only
CONFIG_BTDM_CTRL_MODE_BLE_ONLY=y
CONFIG_LOG_DEFAULT_LEVEL_INFO=y
```
